## conf/layer.conf
```bitbake
# We have a conf and classes directory, add to BBPATH
BBPATH .= ":${LAYERDIR}"

# We have recipes-* directories, add to BBFILES
BBFILES += "${LAYERDIR}/recipes-*/*/*.bb \
            ${LAYERDIR}/recipes-*/*/*.bbappend"

BBFILE_COLLECTIONS += "meta-viyara"
BBFILE_PATTERN_meta-viyara = "^${LAYERDIR}/"
BBFILE_PRIORITY_meta-viyara = "6"

LAYERDEPENDS_meta-viyara = "core"
LAYERSERIES_COMPAT_meta-viyara = "kirkstone"
```
